ORG 0000h


MOV A,#38H ;use 2 lines
ACALL COMNWRT
MOV A,#0EH ;cursor blinking off
ACALL COMNWRT
MOV A , #80H ;FORCE CURSOR TO FIRST LINE
ACALL COMNWRT

MOV A, #01H ;clear screen
ACALL COMNWRT
MOV TMOD, #01h

MOV R3,#1H
MOV P0,R3

MOV R2,#16
MOV DPTR,#STR
;JZ REV
;Message 1&2
MSG:    MOV A,#00H
		MOVC A,@A+DPTR
		;JZ FINISH
		ACALL DATAWRT
		INC DPTR
		DJNZ R2,MSG
		
		
ACALL DELAY
ACALL DELAY
MOV A ,#0C0H 
ACALL COMNWRT

MOV R2,#16
MOV DPTR,#ANS
MSG2:   MOV A,#00H
		MOVC A,@A+DPTR
		;JZ FINISH
		ACALL DATAWRT
		INC DPTR
		DJNZ  R2,MSG2
		
ACALL DELAY
ACALL DELAY	

MOV A,R3
MOV B,#2H
MUL AB
MOV P0,A
MOV R3,A

;Message 3&4

MOV A, #01H 
ACALL COMNWRT
MOV A ,#80H 
ACALL COMNWRT
MOV R2,#16
MOV DPTR,#NEXT
MSG3:   MOV A,#00H
		MOVC A,@A+DPTR
		;JZ FINISH
		ACALL DATAWRT
		INC DPTR
		DJNZ R2,MSG3
		

MOV A ,#0C0H 
ACALL COMNWRT

ACALL DELAY
ACALL DELAY	


MOV R2,#16
MOV DPTR,#ANS2
MSG4:   MOV A,#00H
		MOVC A,@A+DPTR
		ACALL DATAWRT
		INC DPTR
		DJNZ  R2,MSG4

ACALL DELAY
ACALL DELAY

;Message 5&6

MOV A,R3
MOV B,#2H
MUL AB
MOV P0,A
MOV R3,A
MOV A, #01H 
ACALL COMNWRT
MOV A ,#80H 
ACALL COMNWRT

MOV R2,#16
MOV DPTR,#CLN1
MSG5:   MOV A,#00H
		MOVC A,@A+DPTR
		;JZ FINISH
		ACALL DATAWRT
		INC DPTR
		DJNZ  R2,MSG5
		
ACALL DELAY
ACALL DELAY
MOV A ,#0C0H 
ACALL COMNWRT

ACALL DELAY
ACALL DELAY	


MOV R2,#16
MOV DPTR,#CLN2
MSG6:   MOV A,#00H
		MOVC A,@A+DPTR
		;JZ FINISH
		ACALL DATAWRT
		INC DPTR
		DJNZ  R2,MSG6

ACALL DELAY
ACALL DELAY
MOV A, #01H 
ACALL COMNWRT
MOV A ,#80H 
ACALL COMNWRT

;Message 7&8

MOV A,R3
MOV B,#2H
MUL AB
MOV P0,A
MOV R3,A

MOV R2,#16
MOV DPTR,#FIN
FINISH: MOV A,#00H
		MOVC A,@A+DPTR
		;JZ AGAIN
		ACALL DATAWRT
		INC DPTR
		DJNZ  R2,FINISH
		
MOV A ,#0C0H 
ACALL COMNWRT

ACALL DELAY
ACALL DELAY	

MOV R2,#16
MOV DPTR,#FIN2
FINISH2:    MOV A,#00H
			MOVC A,@A+DPTR
			JZ AGAIN
			ACALL DATAWRT
			INC DPTR
			DJNZ  R2,FINISH2
AGAIN: SJMP AGAIN
		
STR:  DB 'Current ','Station '
ANS:  DB 'BHOPAL Junction ' 
NEXT: DB '  Next Station  ' 
ANS2: DB 'NAGPUR Junction '
CLN2: DB 'Keep Train Clean'
CLN1: DB ' Do Not Litter  '	
FIN: DB 'STATION ARRIVED '
FIN2: DB 'WelcomeTo NAGPUR'
	


COMNWRT:
		ACALL DISPLAY
		MOV P1,A
		CLR P2.1 ; rs/data,R/W,E
		SETB P2.2
		CLR P2.2
		RET
		
DATAWRT:
	ACALL DISPLAY ;MOVE DATA TO LCD
	MOV P1,A
	SETB P2.1
	SETB P2.2
	CLR P2.2
	RET
	
DELAY:		MOV R0, #14
			MOV Tl0, #00h
			MOV TH0, #00h
			SETB TR0


DISPLAY: MOV R0,#0FFH
HERE1: MOV R1,#0FFH
HERE2: DJNZ R1,HERE2
	   DJNZ R0,HERE1
	   RET 
	

END